## layers/meta-balena-jetson/conf/machine/cti-rogue-xavier.conf
```bitbake
#@TYPE: Machine
##@NAME: cti-rogue-xavier
##@DESCRIPTION: Machine configuration for the CTI Rogue Carrier Board for NVidia Jetson Xavier


KERNEL_DEVICETREE ?= "_ddot_/_ddot_/_ddot_/_ddot_/nvidia/platform/t19x/galen/kernel-dts/tegra194-agx-cti-AGX101.dtb"
KBUILD_DEFCONFIG_KMACHINE ?= "_ddot_/_ddot_/_ddot_/_ddot_/arch/arm64/configs/cti_tegra_defconfig"

MACHINEOVERRIDES = "jetson-xavier:${MACHINE}"
include conf/machine/jetson-xavier.conf
```
